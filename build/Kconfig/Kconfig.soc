## build/mcuboot/Kconfig/Kconfig.modules
```kconfig
menu "nrf (C:\nrf_workspace\test1_5\nrf)"
osource "C:/nrf_workspace/test1_5/nrf/Kconfig.nrf"
config ZEPHYR_NRF_MODULE
	bool
	default y
endmenu
menu "mcuboot (C:\nrf_workspace\test1_5\mcuboot)"
osource "$(ZEPHYR_MCUBOOT_KCONFIG)"
config ZEPHYR_MCUBOOT_MODULE
	bool
	default y
endmenu
menu "nrfxlib (C:\nrf_workspace\test1_5\nrfxlib)"
osource "C:/nrf_workspace/test1_5/nrfxlib/Kconfig.nrfxlib"
config ZEPHYR_NRFXLIB_MODULE
	bool
	default y
endmenu
menu "hal_nordic (C:\nrf_workspace\test1_5\modules\hal\nordic)"
osource "$(ZEPHYR_HAL_NORDIC_KCONFIG)"
config ZEPHYR_HAL_NORDIC_MODULE
	bool
	default y
endmenu
menu "cddl-gen (C:\nrf_workspace\test1_5\modules\lib\cddl-gen)"
osource "$(ZEPHYR_CDDL_GEN_KCONFIG)"
config ZEPHYR_CDDL_GEN_MODULE
	bool
	default y
endmenu
menu "connectedhomeip (C:\nrf_workspace\test1_5\modules\lib\connectedhomeip)"
osource "C:/nrf_workspace/test1_5/modules/lib/connectedhomeip/config/nrfconnect/chip-module/Kconfig"
config ZEPHYR_CONNECTEDHOMEIP_MODULE
	bool
	default y
endmenu
```

## build/mcuboot/Kconfig/Kconfig.shield
```kconfig
osource "C:/nrf_workspace/test1_5/nrf/boards/shields/*/Kconfig.shield"
osource "C:/nrf_workspace/test1_5/zephyr/boards/shields/*/Kconfig.shield"
osource "C:/nrf_workspace/test1_5/zephyr/boards/shields/*/Kconfig.shield"
```

## west.yml
```yaml
manifest:
  remotes:
    - name: ncs
      url-base: https://github.com/nrfconnect
    - name: mcuboot-tek
      url-base: https://github.com/vilaneuf
    - name: tek-lib
      url-base: https://gitlab.tekniker.es/ele/Resources/sdk/nordic
  projects:
    - name: sdk-nrf
      remote: ncs
      path: nrf
      revision: v1.5.1
      import: true
      clone-depth: 1
      
    - name: mcuboot
      repo-path: sdk-mcuboot
      remote: mcuboot-tek
      revision: v1.7.99-ncs-branch
      
    - name: ncs-tek
      repo-path: nrf_connect_sdk_tek
      remote: tek-lib
      revision: master_v1.5.1

  self:
    path: app
```
